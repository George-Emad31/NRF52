## CMakeLists.txt
```
#
# Copyright (c) 2020 Nordic Semiconductor
#
# SPDX-License-Identifier: LicenseRef-Nordic-5-Clause
#

cmake_minimum_required(VERSION 3.20.0)
find_package(Zephyr REQUIRED HINTS $ENV{ZEPHYR_BASE})

project(nrf_connect_sdk_fundamentals)

target_sources(app PRIVATE src/main.c)
# STEP 3 - Include the custom files in the build
#target_sources(app PRIVATE src/myfunction.c)
# STEP 7 - Make the addition of custiom files conditional
target_sources_ifdef(CONFIG_MYFUNCTION app PRIVATE src/myfunction.c)
```

## Kconfig
```
#
# Copyright (c) 2020 Nordic Semiconductor
#
# SPDX-License-Identifier: LicenseRef-Nordic-5-Clause
#

source "Kconfig.zephyr"

# STEP 6 - Define a custom Kconfig for enabling myfunction
config MYFUNCTION
	bool "Enable my function"
	default n
```

## sample.yaml
```
sample:
  name: nRF Connect SDK Fundamentals Course - Lesson 3 Exercise 2 Solution
  
common: 
    sysbuild: true
    build_only: true
    integration_platforms: 
      - nrf52dk/nrf52832
      - nrf52833dk/nrf52833
      - nrf52840dk/nrf52840
      - nrf9160dk/nrf9160/ns
      - nrf9161dk/nrf9161/ns
      - nrf9151dk/nrf9151/ns
      - nrf5340dk/nrf5340/cpuapp
      - nrf5340dk/nrf5340/cpuapp/ns
      - nrf54l15dk/nrf54l15/cpuapp
      - nrf54l15dk/nrf54l15/cpuapp/ns
      - nrf7002dk/nrf5340/cpuapp
      - nrf7002dk/nrf5340/cpuapp/ns
      - thingy53/nrf5340/cpuapp
      - thingy53/nrf5340/cpuapp/ns
      - thingy91/nrf9160/ns
      - thingy91x/nrf9151/ns
    platform_exclude:
      - native_sim
    
tests:
  ncs_fund.l3.e2_sol: {}
```

## prj.conf
```kconfig
#
# Copyright (c) 2020 Nordic Semiconductor
#
# SPDX-License-Identifier: LicenseRef-Nordic-5-Clause
#

# STEP 8 - Enable the Kconfig for myfunction
CONFIG_MYFUNCTION=y
```

## boards/nrf54l15dk_nrf54l15_cpuapp_ns.overlay
```dts
/* STEP 13 - Change the baud rate for uart20 */
&uart20 {
	current-speed = <9600>;
};
```

## boards/nrf7002dk_nrf5340_cpuapp_ns.overlay
```dts
/* STEP 13 - Change the baud rate for uart0 */
&uart0 {
	current-speed = <9600>;
};
```

## src/main.c
```c
/*
 * Copyright (c) 2022 Nordic Semiconductor ASA
 *
 * SPDX-License-Identifier: LicenseRef-Nordic-5-Clause
 */

#include <zephyr/kernel.h>
#include <zephyr/sys/printk.h>

/* STEP 4 - Include the header file for the custom function */
// include "myfunction.h"

/* STEP 9.1 - Check CONFIG_MYFUNCTION before including the header file */
#ifdef CONFIG_MYFUNCTION
#include "myfunction.h"
#endif

/* STEP 9.2 - Check CONFIG_MYFUNCTION before calling sum() */
int main(void)
{
	while (1) {
#ifdef CONFIG_MYFUNCTION
		int a = 3, b = 4;
		printk("The sum of %d and %d is %d\n", a, b, sum(a, b));
#else
		printk("MYFUNCTION not enabled\n");
		return 0;
#endif
		k_msleep(1000);
	}
	return 0;
}

/* STEP 5 - Change main() to run the custom function */
/*int main(void)
{
	int a = 3, b = 4;
	while(1){
		printk("The sum of %d and %d is %d\n", a, b, sum(a,b));
		k_msleep(1000);
	}
}*/
```

## src/myfunction.c
```c
/*
 * Copyright (c) 2022 Nordic Semiconductor ASA
 *
 * SPDX-License-Identifier: LicenseRef-Nordic-5-Clause
 */

/* STEP 2.1 - Define the function sum() */
#include "myfunction.h"

int sum(int a, int b){
    return a+b;
}
```

## src/myfunction.h
```c
/*
 * Copyright (c) 2022 Nordic Semiconductor ASA
 *
 * SPDX-License-Identifier: LicenseRef-Nordic-5-Clause
 */

/* STEP 2.2 - Declare the function sum() */
#ifndef MY_FUNCTION_H
#define MY_FUNCTION_H

int sum(int a, int b);

#endif
```
